## arch/arm/Kconfig.htc
```kconfig
comment "HTC Debugging Features"
menuconfig HTC_DEBUG
	bool "HTC Debugging Feature Switch"
	default y
	help
	  Enable collection of debug features.
	  This feature is enabled in defconfig.

comment "HTC features"
menuconfig HTC_FEATURES
	bool "HTC Implement Features"
	default n
	help
	  Enable collection of HTC features.
	  This feature is enabled in defconfig.

config HTC_FEATURES_FINAL_EFS_SYNC
	bool "Final EFS SYNC"
	depends on HTC_FEATURES
	default n
	help
	  Enable the trigger of final efs sync before shutdown/reboot
	  This feature is enabled in defconfig.

config HTC_FEATURES_SSR
	bool "HTC style ssr features"
	depends on HTC_FEATURES && MSM_SUBSYSTEM_RESTART
	default n
	help
	  Say Y here if you want the HTC style ssr features

config HTC_FEATURES_SSR_MODEM_ENABLE
	bool "HTC style modem ssr features"
	depends on HTC_FEATURES_SSR
	default n
	help
	  Say Y here if you want the HTC style for modem ssr features

config HTC_FEATURES_SSR_WCNSS_ENABLE
	bool "HTC style wcnss ssr features"
	depends on HTC_FEATURES_SSR
	default n

config AUD_8x16_MI2S
	bool "HTC audio speaker with mi2s on 8x16"
	depends on HTC_FEATURES
	default n

config HTC_AUD_MBHC
	bool "HTC audio with mbhc"
	depends on HTC_FEATURES
	default n

config HTC_AUD_SRS_ENABLE
	bool "HTC audio support SRS effect"
	depends on HTC_FEATURES
	default n

config HTC_DEFAULT_ENABLED_FEATURES
	bool "Select default enabled config for HTC projects"
	default y
	select COMPACTION
	help
	  Default y to select other configs which should be enabled by default
	  for HTC projects.

config HTC_BUILD_EDIAG
	bool "Build in embedded diag fixes"
	default n
	help
	  For embedded diag we need to do some additional fixes.

config ENLARGE_RADIO_BUFFER
	bool "Enlarge radio buffer"
	default n
	help
	  Enlarge radio buffer for two rild project.

config HTC_RPM_CMD
	bool "HTC homebrew command interface"
	depends on MSM_RPM || MSM_RPM_SMD
	default n
	help
	  This expose HTC RPM command interface for different purpose.

config HTC_FEATURES_RIL_PCN0001_REBOOT_WITH_ERASE_EFS
	bool "Reboot with ERASE_EFS reason when SMSM_ERASE_EFS raised"
	default y
	help
	  When modem met fatal,
	  It will enable bit RESTART_MODE_ERASE_EFS.
	  Then when device reboot, it will clean up EFS.

config HTC_FEATURES_RIL_PCN0003_HTC_MONITOR
	tristate "HTC_FEATURES_RIL_PCN0003_HTC_MONITOR"
	default n
	---help---
	  Come up with a way to add information of data usage in attribute file
	  for identifying the process that requested for data transmission.

config HTC_FEATURES_RIL_PCN0004_HTC_GARBAGE_FILTER
	tristate "HTC_FEATURES_RIL_PCN0004_HTC_GARBAGE_FILTER"
	default n
	depends on MSM_SMD
	---help---
	  Garbage Filter of TCP

config HTC_FEATURES_RIL_PCN0007_FINAL_EFS_SYNC
	tristate "HTC_DEBUG_RIL_PCN0007_FINAL_EFS_SYNC"
	default y
	---help---
	  Trigger modem EFS sync when device reboot
```

## drivers/htc_debug/stability/Kconfig
```kconfig
#
# HTC_DEBUG stability Kconfig
#

config HTC_DEBUG_PAGE_ENTRIES_NR
	int
	default 8
```
